#include "MKL05Z4.h"
#include <stdio.h>
#include <string.h>
#include <stdlib.h>
#define RST_POS 1
#define CE_POS 2
#define DC_POS 8
#define DIN_POS 6
#define CLK_POS 7

//wymiary wyswietlacza
#define wid 84
#define hei 6

#define right 1
#define up 2
#define left 3
#define down 4
//Macierz z pikselami
uint8_t RAM[wid*hei];
/*Macierz ze wspolrzednymi dolu weza przy ulozeniu poziomym
Waz ma grubosc 2 piksele, skaluje obraz - wyswietlam tylko czworki pikseli 2x2
wspolrzedne x macierzy naleza od 1 do 40
wspolrzedne y macierzy naleza od 1 do 22*/
uint8_t snake[880][2];
int snake_length;
uint8_t direction=1; //direction 1->prawo; 2->gora 3->lewo 4->dol
uint8_t food_eaten=1;
int timer;
uint8_t x_food;
uint8_t y_food;
int score;
int high_score;
int game_over;
const unsigned char game_over_screen[wid*hei] ={/*1*/0x0,0x0,0x0,0x0,0xff,0xff,0xff,0xff,0xf,0xf,0xf,0xf,0xf,0xf,0xf,0xf,0xf,0xf,0xf,0xf,0x0,0x0,0x0,0x0,0x0,0x0,0x0,0x0,0xf0,0xf0,
	0xf0,0xf0,0xf,0xf,0xf,0xf,0xf0,0xf0,0xf0,0xf0,0x0,0x0,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0xff,
	0x0,0x0,0x0,0x0,0xff,0xff,0xff,0xff,0xf,0xf,0xf,0xf,0xf,0xf,0xf,0xf,/*2*/0x0,0x0,0x0,0x0,0xff,0xff,0xff,0xff,0x0,0x0,0x0,0x0,0xf,0xf,0xf,0xf,0xff,0xff,0xff,0xff,0x0,0x0,
	0x0,0x0,0xff,0xff,0xff,0xff,0xf,0xf,0xf,0xf,0xf,0xf,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0x0,
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0xf0,0x0,0x0,0x0,0x0,0xff,0xff,0xff,0xff,0x0,0x0,0x0,0x0,0xf,0xf,0xf,0xf,0xf0,0xf0,0xf0,0xf0};

const unsigned char home_screen[wid*hei] ={/*1*/0x0,0x0,0x0,0x0,0x0,0x0,0x0,0x0,0xf0,0xf0,0xf0,0xf0,0xf0,0xf0,0xf0,0xf0,0x0,0x0,0x0,0x0,0x0,0x0,0x0,0x0,0x0,0x0,0x0,0x0,0x0,0x0,0x0,0x0,
	0x0,0x0,0x0,0x0,0x0,0x0,0x0,0x0,0x0,0x0,0x0,0x0,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0x0,
	/*2*/0x0,0x0,0x0,0x0,0xff,0xff,0xff,0xff,0x0,0x0,0x0,0x0,0x0,0x0,0x0,0x0,0x0,0x0,0x0,0x0,0x0,0x0,0x0,0x0,0x0,0x0,0x0,0x0,0x0,0x0,0x0,0x0,0x0,0x0,0x0,0x0,0x0,0x0,0x0,0x0,0x0,0x0,0x0,0x0,0x0,0x0,0x0,0x0,0x0,0x0,0x0,0x0,
	0x0,0x0,0x0,0x0,0xff,0xff,0xff,0xff,0x0,0x0,0x0,0x0,0x0,0x0,0x0,0x0,0x0,0x0,0x0,0x0,0x0,0x0,0x0,0x0,0x0,0x0,0x0,0x0,0x0,0x0,0x0,0x0,
	/*3*/0x0,0x0,0x0,0x0,0xff,0xff,0xff,0xff,0x0,0x0,0x0,0x0,0x0,0x0,0x0,0x0,0x0,0x0,0x0,0x0,0x0,0x0,0x0,0x0,0x0,0x0,0x0,0x0,0x0,0x0,0x0,0x0,0x0,0x0,0x0,0x0,0x0,0x0,0x0,0x0,0x0,0x0,0x0,0x0,0x0,0x0,0x0,0x0,0x0,0x0,0x0,0x0,
	0x0,0x0,0x0,0x0,0xff,0xff,0xff,0xff,0xf0,0xf0,0xf0,0xf0,0xf,0xf,0xf,0xf,0xf0,0xf0,0xf0,0xf0,0xff,0xff,0xff,0xff,0xff,0xff,0xff,0xff,0xf0,0xf0,0xf0,0xf0,
	/*4*/0x0,0x0,0x0,0x0,0xf,0xf,0xf,0xf,0xff,0xff,0xff,0xff,0x0,0x0,0x0,0x0,0xff,0xff,0xff,0xff,0xf,0xf,0xf,0xf,0xf0,0xf0,0xf0,0xf0,0x0,0x0,0x0,0x0,0xff,0xff,0xff,0xff,0xf,0xf,0xf,0xf,0xff,0xff,0xff,0xff,0x0,0x0,0x0,0x0,
	0x0,0x0,0x0,0x0,0x0,0x0,0x0,0x0,0xff,0xff,0xff,0xff,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0xff,
	/*5*/0xf0,0xf0,0xf0,0xf0,0xf0,0xf0,0xf0,0xf0,0xff,0xff,0xff,0xff,0x0,0x0,0x0,0x0,0xff,0xff,0xff,0xff,0x0,0x0,0x0,0x0,0xff,0xff,0xff,0xff,0x0,0x0,0x0,0x0,
	0xff,0xff,0xff,0xff,0xf0,0xf0,0xf0,0xf0,0xff,0xff,0xff,0xff,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0x0,
	/*6*/0x0,0x0,0x0,0x0,0x0,0x0,0x0,0x0,0x0,0x0,0x0,0x0,0x0,0x0,0x0,0x0,0x0,0x0,0x0,0x0,0x0,0x0,0x0,0x0,0x0,0x0,0x0,0x0,0x0,0x0,0x0,0x0,0x0,0x0,0x0,0x0,0x0,0x0,0x0,0x0,0x0,0x0,0x0,0x0,0x0,0x0,0x0,0x0,0x0,0x0,
	0x0,0x0,0x0,0x0,0x0,0x0,0x0,0x0,0x0,0x0,0x0,0x0,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0x0,
	0x0,0x0,0x0,0x0};
void delay_us( int n) {
	volatile int i;
	volatile int j;
	for( i = 0 ; i < n; i++)
		for(j = 0; j < 4; j++) {}
}

void delay_ms( int n) {
	volatile int i;
	volatile int j;
	for( i = 0 ; i < n; i++)
		for(j = 0; j < 3500; j++) {}
}

void setup()
{
	SIM->SCGC5 |=  SIM_SCGC5_PORTB_MASK; 				//Enable clock for port B
	//set pins as GPIO
	PORTB->PCR[RST_POS] |= PORT_PCR_MUX(1);    
	PORTB->PCR[CE_POS] |= PORT_PCR_MUX(1);      
	PORTB->PCR[DC_POS] |= PORT_PCR_MUX(1); 
	PORTB->PCR[DIN_POS] |= PORT_PCR_MUX(1);
	PORTB->PCR[CLK_POS] |= PORT_PCR_MUX(1);
	//set pins as output
	PTB->PDDR |= ((1<<RST_POS)|(1<<CE_POS)|(1<<DC_POS)|(1<<DIN_POS)|(1<<CLK_POS));
}	

void set_portb_bit(uint8_t n){
	PTB->PDOR|=(1<<n);
}
void clear_portb_bit(uint8_t n){
	PTB->PDOR&=~(1<<n);
}
uint8_t check_bit(uint8_t data, uint8_t n){
	if(data&(1<<n)){
		return 1;
	}
	else{
		return 0;
	}
}

void pass_data( uint8_t data )
{
	//umozliwiamy przesyl danych
	clear_portb_bit(CE_POS);

	//szeregowa transmisja
	for(int i=7; i>=0; i--)
	{
		if(check_bit(data,i))
			set_portb_bit(DIN_POS);
		else
			clear_portb_bit(DIN_POS);
		
		//zegar taktujacy wyswietlacz
		set_portb_bit(CLK_POS);
		delay_us(2);
		clear_portb_bit(CLK_POS);
		delay_us(2);
	}

	//konczymy przesyl
	set_portb_bit(CE_POS);
}

//komenda wyswietlacza- czyszczenie ekranu
void display_blank(){
	clear_portb_bit(DC_POS);
	pass_data(0x8);
	set_portb_bit(DC_POS);
}
//komenda wyswietlacz- zmiana kolorow na normalne
void display_normal(){
	clear_portb_bit(DC_POS);
	pass_data(0xc);
	set_portb_bit(DC_POS);
}
//komenda wyswietlacza- zmiana kolorow na inverse
void display_inverse(){
	clear_portb_bit(DC_POS);
	pass_data(0xd);
	set_portb_bit(DC_POS);
}

void NOKIA_INIT()
{
	//reset pulse
	clear_portb_bit(RST_POS);
	
	delay_ms(2);
	
	set_portb_bit(RST_POS);

	//CE na start w stan wysoki
	set_portb_bit(CE_POS);
	
	//tryb konfiguracji
	clear_portb_bit(DC_POS);
	
	//konfiguracja
	pass_data(0x21); 
	pass_data(0xb6);
	pass_data(0x4); 
	pass_data(0x14);
	pass_data(0x20);
	pass_data(0xc);
	
	//tryb danych
	set_portb_bit(DC_POS);
}

//c-znak; x,y - pozycja przedzial x to <0,83>, y to <0,5>
//kazdy znak ma 5 pikseli szerokosci
void set_char(unsigned char c, uint8_t x, uint8_t y){
	int pos = wid*y + x;
	
	switch(c){
		case 'A':
		RAM[pos] |= 0xfc;
		RAM[pos + 1] |= 0x12;
		RAM[pos + 2] |= 0x12;
		RAM[pos + 3] |= 0x12;
		RAM[pos + 4] |= 0xfc;
		break;
		case 'B':
		RAM[pos] |= 0xfe;
		RAM[pos + 1] |= 0x92;
		RAM[pos + 2] |= 0x92;
		RAM[pos + 3] |= 0x92;
		RAM[pos + 4] |= 0x6c;
		break;
		case 'C':
		RAM[pos] |= 0x7c;
		RAM[pos + 1] |= 0x82;
		RAM[pos + 2] |= 0x82;
		RAM[pos + 3] |= 0x82;
		RAM[pos + 4] |= 0x44;
		break;
		case 'D':
		RAM[pos] |= 0xfe;
		RAM[pos + 1] |= 0x82;
		RAM[pos + 2] |= 0x82;
		RAM[pos + 3] |= 0x82;
		RAM[pos + 4] |= 0x7c;
		break;
		case 'E':
		RAM[pos] |= 0xfe;
		RAM[pos + 1] |= 0x92;
		RAM[pos + 2] |= 0x92;
		RAM[pos + 3] |= 0x92;
		RAM[pos + 4] |= 0x82;
		break;
		case 'F':
		RAM[pos] |= 0xfe;
		RAM[pos + 1] |= 0x12;
		RAM[pos + 2] |= 0x12;
		RAM[pos + 3] |= 0x12;
		RAM[pos + 4] |= 0x2;
		break;
		case 'G':
		RAM[pos] |= 0x7c;
		RAM[pos + 1] |= 0x82;
		RAM[pos + 2] |= 0x82;
		RAM[pos + 3] |= 0xa2;
		RAM[pos + 4] |= 0x64;
		break;
		case 'H':
		RAM[pos] |= 0xfe;
		RAM[pos + 1] |= 0x10;
		RAM[pos + 2] |= 0x10;
		RAM[pos + 3] |= 0x10;
		RAM[pos + 4] |= 0xfe;
		break;
		case 'I':
		RAM[pos] |= 0x0;
		RAM[pos + 1] |= 0x82;
		RAM[pos + 2] |= 0xfe;
		RAM[pos + 3] |= 0x82;
		RAM[pos + 4] |= 0x0;
		break;
		case 'J':
		RAM[pos] |= 0x40;
		RAM[pos + 1] |= 0x80;
		RAM[pos + 2] |= 0x82;
		RAM[pos + 3] |= 0x7e;
		RAM[pos + 4] |= 0x2;
		break;
		case 'K':
		RAM[pos] |= 0xfe;
		RAM[pos + 1] |= 0x10;
		RAM[pos + 2] |= 0x28;
		RAM[pos + 3] |= 0x44;
		RAM[pos + 4] |= 0x82;
		break;
		case 'L':
		RAM[pos] |= 0xfe;
		RAM[pos + 1] |= 0x80;
		RAM[pos + 2] |= 0x80;
		RAM[pos + 3] |= 0x80;
		RAM[pos + 4] |= 0x80;
		break;
		case 'M':
		RAM[pos] |= 0xfe;
		RAM[pos + 1] |= 0x4;
		RAM[pos + 2] |= 0x18;
		RAM[pos + 3] |= 0x4;
		RAM[pos + 4] |= 0xfe;
		break;
		case 'N':
		RAM[pos] |= 0xfe;
		RAM[pos + 1] |= 0x8;
		RAM[pos + 2] |= 0x10;
		RAM[pos + 3] |= 0x20;
		RAM[pos + 4] |= 0xfe;
		break;
		case 'O':
		RAM[pos] |= 0x7c;
		RAM[pos + 1] |= 0x82;
		RAM[pos + 2] |= 0x82;
		RAM[pos + 3] |= 0x82;
		RAM[pos + 4] |= 0x7c;
		break;
		case 'P':
		RAM[pos] |= 0xfe;
		RAM[pos + 1] |= 0x12;
		RAM[pos + 2] |= 0x12;
		RAM[pos + 3] |= 0x12;
		RAM[pos + 4] |= 0xc;
		break;
		case 'Q':
		RAM[pos] |= 0x7c;
		RAM[pos + 1] |= 0x82;
		RAM[pos + 2] |= 0xa2;
		RAM[pos + 3] |= 0x42;
		RAM[pos + 4] |= 0xbc;
		break;
		case 'R':
		RAM[pos] |= 0xfe;
		RAM[pos + 1] |= 0x12;
		RAM[pos + 2] |= 0x32;
		RAM[pos + 3] |= 0x52;
		RAM[pos + 4] |= 0x8c;
		break;
		case 'S':
		RAM[pos] |= 0x8c;
		RAM[pos + 1] |= 0x92;
		RAM[pos + 2] |= 0x92;
		RAM[pos + 3] |= 0x92;
		RAM[pos + 4] |= 0x62;
		break;
		case 'T':
		RAM[pos] |= 0x2;
		RAM[pos + 1] |= 0x2;
		RAM[pos + 2] |= 0xfe;
		RAM[pos + 3] |= 0x2;
		RAM[pos + 4] |= 0x2;
		break;
		case 'U':
		RAM[pos] |= 0x7e;
		RAM[pos + 1] |= 0x80;
		RAM[pos + 2] |= 0x80;
		RAM[pos + 3] |= 0x80;
		RAM[pos + 4] |= 0x7e;
		break;
		case 'V':
		RAM[pos] |= 0x1e;
		RAM[pos + 1] |= 0x60;
		RAM[pos + 2] |= 0x80;
		RAM[pos + 3] |= 0x60;
		RAM[pos + 4] |= 0x1e;
		break;
		case 'W':
		RAM[pos] |= 0x7e;
		RAM[pos + 1] |= 0x80;
		RAM[pos + 2] |= 0x70;
		RAM[pos + 3] |= 0x80;
		RAM[pos + 4] |= 0x7e;
		break;
		case 'X':
		RAM[pos] |= 0xc6;
		RAM[pos + 1] |= 0x28;
		RAM[pos + 2] |= 0x10;
		RAM[pos + 3] |= 0x28;
		RAM[pos + 4] |= 0xc6;
		break;
		case 'Y':
		RAM[pos] |= 0x6;
		RAM[pos + 1] |= 0x8;
		RAM[pos + 2] |= 0xf0;
		RAM[pos + 3] |= 0x8;
		RAM[pos + 4] |= 0x6;
		break;
		case 'Z':
		RAM[pos] |= 0xc2;
		RAM[pos + 1] |= 0xa2;
		RAM[pos + 2] |= 0x92;
		RAM[pos + 3] |= 0x8a;
		RAM[pos + 4] |= 0x86;
		break;
		case 1:
		RAM[pos] |= 0x0;
		RAM[pos + 1] |= 0x84;
		RAM[pos + 2] |= 0xfe;
		RAM[pos + 3] |= 0x80;
		RAM[pos + 4] |= 0x0;
		break;
		case 2:
		RAM[pos] |= 0x84;
		RAM[pos + 1] |= 0xc2;
		RAM[pos + 2] |= 0xa2;
		RAM[pos + 3] |= 0x92;
		RAM[pos + 4] |= 0x8c;
		break;
		case 3:
		RAM[pos] |= 0x42;
		RAM[pos + 1] |= 0x82;
		RAM[pos + 2] |= 0x8a;
		RAM[pos + 3] |= 0x96;
		RAM[pos + 4] |= 0x62;
		break;
		case 4:
		RAM[pos] |= 0x30;
		RAM[pos + 1] |= 0x28;
		RAM[pos + 2] |= 0x24;
		RAM[pos + 3] |= 0xfe;
		RAM[pos + 4] |= 0x20;
		break;
		case 5:
		RAM[pos] |= 0x4e;
		RAM[pos + 1] |= 0x8a;
		RAM[pos + 2] |= 0x8a;
		RAM[pos + 3] |= 0x8a;
		RAM[pos + 4] |= 0x72;
		break;
		case 6:
		RAM[pos] |= 0x78;
		RAM[pos + 1] |= 0x94;
		RAM[pos + 2] |= 0x92;
		RAM[pos + 3] |= 0x92;
		RAM[pos + 4] |= 0x60;
		break;
		case 7:
		RAM[pos] |= 0x2;
		RAM[pos + 1] |= 0xe2;
		RAM[pos + 2] |= 0x12;
		RAM[pos + 3] |= 0xa;
		RAM[pos + 4] |= 0x6;
		break;
		case 8:
		RAM[pos] |= 0x6c;
		RAM[pos + 1] |= 0x92;
		RAM[pos + 2] |= 0x92;
		RAM[pos + 3] |= 0x92;
		RAM[pos + 4] |= 0x6c;
		break;
		case 9:
		RAM[pos] |= 0xc;
		RAM[pos + 1] |= 0x92;
		RAM[pos + 2] |= 0x92;
		RAM[pos + 3] |= 0x52;
		RAM[pos + 4] |= 0x3c;
		break;
		case 0:
		RAM[pos] |= 0x7c;
		RAM[pos + 1] |= 0xa2;
		RAM[pos + 2] |= 0x92;
		RAM[pos + 3] |= 0x8a;
		RAM[pos + 4] |= 0x7c;
		break;
		case ' ':
		RAM[pos] |= 0x0;
		RAM[pos + 1] |= 0x0;
		RAM[pos + 2] |= 0x0;
		RAM[pos + 3] |= 0x0;
		RAM[pos + 4] |= 0x0;
		break;
		case ':':
		RAM[pos] |= 0x0;
		RAM[pos + 1] |= 0x0;
		RAM[pos + 2] |= 0x44;
		RAM[pos + 3] |= 0x0;
		RAM[pos + 4] |= 0x0;
		break;
		case '.':
		RAM[pos] |= 0x0;
		RAM[pos + 1] |= 0x0;
		RAM[pos + 2] |= 0x80;
		RAM[pos + 3] |= 0x0;
		RAM[pos + 4] |= 0x0;		
	}
}

//c-napis,len dlugosc;x,y-wspolrzednie poczatku
void set_string(unsigned char c[],uint8_t len,uint8_t x, uint8_t y){
	for(uint8_t i = 0;i<len;i++){
		set_char(c[i],x+i*6,y);
	}
}

//printowanie wyniku
void set_first_digit(int d){
	d = d%10;
	set_char(d,76,1);
}
void set_second_digit(int d){
	d = (d%100)/10;
	set_char(d,70,1);
}
void set_third_digit(int d){
	d = (d%1000)/100;
	set_char(d,64,1);
}
//czysci ekran
void set_clear(){
	for(int i=0;i<hei*wid;i++){
		RAM[i] = 0;
	}
}
//przekazanie danych do ramu
void display(){
	
	for(int i=0;i<hei*wid;i++){
		pass_data(RAM[i]);
	}
	
}
//wyswietl napis game over
void set_game_over_screen(){
	for (int i=0;i<wid*hei;i++){
		RAM[i] = game_over_screen[i];
	}
}

void set_welcome_screen(){
	for (int i=0;i<wid*hei;i++){
		RAM[i] = home_screen[i];
	}
}
void set_init_screen(){
	set_string("PRESS ANY", 9, 0, 1);
	set_string("BUTTON TO PLAY", 14, 0, 2);
	set_string("LAST SCORE:", 11, 0, 3);
	set_char((score%1000)/100, 66, 3); //third digit
	set_char((score%100)/10, 72, 3);
	set_char(score%10, 78, 3);
	set_string("HIGH SCORE:", 11, 0, 4);
	set_char((high_score%1000)/100, 66, 4); //third digit
	set_char((high_score%100)/10, 72, 4);
	set_char(high_score%10, 78, 4);
}
void set_frame(){
	for(int i=0;i<wid;i++)
	{
		RAM[i]=0x3;
		RAM[wid*(hei-1)+i]=0xc0;
	}
	for(int i=0;i<hei;i++)
	{
		RAM[i*wid]=0xff;
		RAM[i*wid+1]=0xff;
		RAM[wid-1+i*wid]=0xff;
		RAM[wid-2+i*wid]=0xff;
	}
}

void set_clear_without_frame(){
	set_clear();
	set_frame();
}

void init_snake(){	
	snake_length=10;
	for(int i=0;i<snake_length;i++){
		snake[i][0]=20-i; //wsp. x
		snake[i][1]=10; //wsp. y
	}
}

void set_snake(){
	for(int i=0; i<snake_length; i++){
		uint8_t x=snake[i][0];
		uint8_t y=snake[i][1];
		if(x<1 || x>40 || y<1 || y>22)
			return;
		RAM[(y/4)*wid+2*x]|=0x3<<((y%4)*2);
		RAM[(y/4)*wid+2*x+1]|=0x3<<((y%4)*2);
	}
}

void clear_snake(){
	for(int i=0;i<snake_length;i++){
		snake[i][0]=0; //wsp. x
		snake[i][1]=0; //wsp. y
	}
}

void snake_pos(){
	for(int i=0; i<snake_length-1; i++)
	{
		snake[snake_length-1-i][0]=snake[snake_length-2-i][0];
		snake[snake_length-1-i][1]=snake[snake_length-2-i][1];
	}
	if(direction==right)
		snake[0][0]+=1;
	if(direction==up)
		snake[0][1]-=1;
	if(direction==left)
		snake[0][0]-=1;
	if(direction==down)
		snake[0][1]+=1;
	if(snake[0][0]==0)
		snake[0][0]=40;
	if(snake[0][0]==41)
		snake[0][0]=1;
	if(snake[0][1]==0)
		snake[0][1]=22;
	if(snake[0][1]==23)
		snake[0][1]=1;
}
void set_pix(uint8_t x, uint8_t y)
{
	RAM[(y/8)*wid+x]|=1<<(y%8);
}
//jedzenie ma ksztalt iksa
void food_pos_set(){
	if(food_eaten)
	{
		food_eaten=0;
		x_food=(timer*101)%78+3;    					//zakres od 3 do 80
		y_food=(timer*71)%42+3;             	//zakres od 3 do 44
	}
	set_pix(x_food,y_food);
	set_pix(x_food+1, y_food+1);
	set_pix(x_food+1, y_food-1);
	set_pix(x_food-1, y_food-1);
	set_pix(x_food-1, y_food+1);
	set_pix(x_food+1, y_food);
	set_pix(x_food, y_food+1);
	set_pix(x_food-1, y_food);
	set_pix(x_food, y_food-1);
}
void check_food()
{
	uint8_t head_x1=snake[0][0]*2;
	uint8_t head_y1=snake[0][1]*2;
	if(x_food>=head_x1-1 && x_food<=head_x1+2 && y_food>=head_y1-1 && y_food<=head_y1+2){
		food_eaten=1;
		snake_length+=4;
		score+=1;}
}
void check_snake()
{
	for(int i=1; i<snake_length; i++){
		if(snake[0][0]==snake[i][0] && snake[0][1]==snake[i][1])
			game_over=1;
	}
}
void set_score()
{
	set_first_digit(score);
	set_second_digit(score);
	set_third_digit(score);
}

